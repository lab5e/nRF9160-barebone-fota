## CMakeLists.txt
```
#
# Copyright (c) 2020 Nordic Semiconductor
#
# SPDX-License-Identifier: LicenseRef-Nordic-5-Clause
#

cmake_minimum_required(VERSION 3.20.0)

find_package(Zephyr REQUIRED HINTS $ENV{ZEPHYR_BASE})
project(barebone-fota)

# NORDIC SDK APP START
target_sources(app PRIVATE src/main.c)
target_sources(app PRIVATE src/lte/lte.c)
target_sources(app PRIVATE src/lte/connection_info.c)
target_sources(app PRIVATE src/downloader/downloader.c)
target_sources(app PRIVATE src/fota/fota_tlv.c)
target_sources(app PRIVATE src/fota/fota.c)

# NORDIC SDK APP END
zephyr_include_directories(src)
zephyr_include_directories(src/proto)
```

## Kconfig
```
#
# Copyright (c) 2020 Nordic Semiconductor ASA
#
# SPDX-License-Identifier: LicenseRef-Nordic-5-Clause
#

menu "Norture CAO Sensor settings"

config UDP_DATA_UPLOAD_SIZE_BYTES
	int "Number of bytes transmitted to the server"
	default 10

config UDP_DATA_UPLOAD_FREQUENCY_SECONDS
	int "How often data is transmitted to the server"
	default 30

config UART_DATA_UPLOAD_FREQUENCY_SECONDS
	int "How often data is transmitted to the box"
	default 30
	
config UDP_SERVER_ADDRESS
	string "UDP server IP address"
	default "172.16.15.14"

config UDP_SERVER_PORT
	int "UDP server port number"
	default "1234"

config COAP_SERVER_ADDRESS
	string "COAP server IP address"
	default "172.16.15.14"

config FOTA_COAP_REPORT_PATH
	string "COAP FOTA report path"
	default "u"

config FOTA_COAP_UPDATE_PATH
	string "COAP FOTA firmware update path"
	default "fw"
			
config COAP_SERVER_PORT
	int "COAP server port number"
	default "5683"

config UDP_PSM_ENABLE
	bool "Enable LTE Power Saving Mode"
	default y

config UDP_EDRX_ENABLE
	bool "Enable LTE enhanced Discontinuous Reception"

config UDP_RAI_ENABLE
	bool "Enable LTE Release Assistance Indication"

endmenu

module = CO2SENSOR
module-str = CO2 Sensor
source "${ZEPHYR_BASE}/subsys/logging/Kconfig.template.log_config"

menu "Zephyr Kernel"
source "Kconfig.zephyr"
endmenu

module = FOTA
module-str = FOTA
source "subsys/logging/Kconfig.template.log_config"

module = FOTA_DOWNLOAD
module-str = FOTA_DOWNLOAD
source "subsys/logging/Kconfig.template.log_config"
```

## prj.conf
```kconfig
#
# Copyright (c) 2020 Nordic Semiconductor ASA
#
# SPDX-License-Identifier: LicenseRef-Nordic-5-Clause
#

CONFIG_BOOT_BANNER=y
CONFIG_PRINTK=y
CONFIG_STDOUT_CONSOLE=y

# For Segger RTT / Logging
# CONFIG_LOG=y
# CONFIG_UART_CONSOLE=n
# CONFIG_USE_SEGGER_RTT=y
# CONFIG_RTT_CONSOLE=y
# CONFIG_LOG_BACKEND_RTT=y


# MCUBoot
CONFIG_BOOTLOADER_MCUBOOT=y
CONFIG_FLASH_PAGE_LAYOUT=y
CONFIG_FLASH=y
CONFIG_IMG_MANAGER=y
CONFIG_MCUBOOT_IMG_MANAGER=y
CONFIG_MPU_ALLOW_FLASH_WRITE=y
CONFIG_REBOOT=y
CONFIG_MCUBOOT_UTIL_LOG_LEVEL_DBG=y
CONFIG_MCUBOOT_IMAGE_VERSION="1.0.0+1"

# General config
CONFIG_NEWLIB_LIBC=y
CONFIG_NEWLIB_LIBC_FLOAT_PRINTF=y
CONFIG_NCS_SAMPLES_DEFAULTS=y
CONFIG_SERIAL=y

#UART
CONFIG_UART_INTERRUPT_DRIVEN=y

# Network
CONFIG_NETWORKING=y
CONFIG_NET_NATIVE=n
CONFIG_NET_SOCKETS=y
CONFIG_NET_SOCKETS_OFFLOAD=y

# LTE link control
CONFIG_LTE_LINK_CONTROL=y
CONFIG_LTE_AUTO_INIT_AND_CONNECT=n

# Modem library
CONFIG_NRF_MODEM_LIB=y

# Heap and stacks
CONFIG_HEAP_MEM_POOL_SIZE=8192
CONFIG_MAIN_STACK_SIZE=8192
CONFIG_SYSTEM_WORKQUEUE_STACK_SIZE=4096
CONFIG_AT_MONITOR_HEAP_SIZE=512

# LTE parameters
## Network Mode / LTE category
CONFIG_LTE_NETWORK_MODE_LTE_M=y

## PSM
CONFIG_UDP_PSM_ENABLE=y
CONFIG_LTE_PSM_REQ_RPTAU="00100001"
CONFIG_LTE_PSM_REQ_RAT="00000000"

## eDRX
CONFIG_UDP_EDRX_ENABLE=n
CONFIG_LTE_EDRX_REQ_VALUE_LTE_M="1001"

## RAI
CONFIG_UDP_RAI_ENABLE=n
CONFIG_LTE_RAI_REQ_VALUE="4"


CONFIG_PDN=y
CONFIG_PDN_DEFAULTS_OVERRIDE=y
CONFIG_PDN_SYS_INIT=y
# Note: "ip" is set by PDN_DEFAULT_FAM kconfig's
# example:
# AT+CGDCONT=1,"ip","apn" - below only sets APN field
CONFIG_PDN_DEFAULT_FAM_IPV4V6=y


# Span specific
CONFIG_PDN_DEFAULT_APN="mda.lab5e"
CONFIG_UDP_SERVER_ADDRESS="172.16.15.14"
CONFIG_UDP_SERVER_PORT=1234
CONFIG_COAP_SERVER_PORT=5683
CONFIG_UDP_DATA_UPLOAD_FREQUENCY_SECONDS=1
CONFIG_UART_DATA_UPLOAD_FREQUENCY_SECONDS=1

# COAP
CONFIG_COAP=y

#I2C
CONFIG_I2C=y
CONFIG_I2C_NRFX=y
	
# GPIO
CONFIG_GPIO=y    

#ADC
CONFIG_ADC=y

# Download Client
CONFIG_DOWNLOAD_CLIENT=y
CONFIG_DOWNLOAD_CLIENT_COAP_BLOCK_SIZE_256=y
CONFIG_BUILD_WITH_TFM=y
CONFIG_DOWNLOAD_CLIENT_LOG_LEVEL_DBG=y

# FOTA
CONFIG_FOTA_LOG_LEVEL_DBG=y
CONFIG_FOTA_DOWNLOAD_LOG_LEVEL_DBG=y
```

## src/main.c
```c
#include <zephyr/kernel.h>
#include <stdio.h>
// #include <modem/lte_lc.h>
// #include <zephyr/net/socket.h>
#include <zephyr/dfu/mcuboot.h>

#include "lte/lte.h"
#include "fota/fota.h"

void main(void)
{
	printk("================================================\n");
	printk("nRF9160 FOTA sample has started (Version 1.0.XX)\n");
	printk("================================================\n");


	// Note:
	// If boot_write_img_confirmed() is not called, MCUBoot will revert to the previous
	// image on the next boot.
	boot_write_img_confirmed();

	lte_work_init();

	// Note: 
	// fota_run() will block until firmware download is complete

	fota_run();

	// Start any worker threads here.

	while (true)
	{
		// ..or process stuff in the main thread.
		k_sleep(K_MSEC(3000));
		printk("Ping...\n");
	}
}
```
